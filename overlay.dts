/dts-v1/;
/plugin/;
/ {
	fragment@0 {
		target = <&i2c1>;
		__overlay__ {
			#address-cells = <1>;
			#size-cells = <0>;

			pcf_lcd: pcf_lcd@27 {
				compatible = "pcf,lcd";
				reg = <0x27>;
				status = "okay";
			};
		};
	};
};
